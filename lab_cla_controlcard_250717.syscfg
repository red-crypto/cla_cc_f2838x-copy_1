/**
 * @cliArgs --board "/boards/TMDSCNCD28388D" --device "F2838x" --part "F2838x_337bga" --package "337bga" --context "CPU1" --product "C2000WARE@5.05.00.00"
 * @versions {"tool":"1.24.0+4110"}
 */

/**
 * Import the modules used in this configuration.
 */
const adc       = scripting.addModule("/driverlib/adc.js", {}, false);
const adc1      = adc.addInstance();
const led       = scripting.addModule("/driverlib/board_components/led", {}, false);
const led1      = led.addInstance();
const cla       = scripting.addModule("/driverlib/cla.js", {}, false);
const cla1      = cla.addInstance();
const cputimer  = scripting.addModule("/driverlib/cputimer.js", {}, false);
const cputimer1 = cputimer.addInstance();
const cputimer2 = cputimer.addInstance();
const cputimer3 = cputimer.addInstance();
const gpio      = scripting.addModule("/driverlib/gpio.js", {}, false);
const gpio1     = gpio.addInstance();
const memcfg    = scripting.addModule("/driverlib/memcfg.js");
const sci       = scripting.addModule("/driverlib/sci.js", {}, false);
const sci1      = sci.addInstance();

/**
 * Write custom configuration values to the imported modules.
 */
adc1.$name                          = "myADC0";
adc1.adcClockPrescaler              = "ADC_CLK_DIV_4_0";
adc1.enabledSOCs                    = ["ADC_SOC_NUMBER0"];
adc1.soc0Trigger                    = "ADC_TRIGGER_EPWM2_SOCA";
adc1.interruptPulseMode             = "ADC_PULSE_END_OF_CONV";
adc1.enabledInts                    = ["ADC_INT_NUMBER1"];
adc1.enableInterrupt1               = true;
adc1.enableInterrupt1ContinuousMode = true;
adc1.soc0SampleWindow               = 15;

led1.$name     = "myBoardLED0";
led1.$hardware = system.deviceData.board.components.D2;

cla1.$name             = "myCLA0";
cla1.enable_CLA_TASK_2 = false;
cla1.enable_CLA_TASK_3 = false;
cla1.enable_CLA_TASK_4 = false;
cla1.enable_CLA_TASK_6 = false;
cla1.enable_CLA_TASK_5 = false;
cla1.enable_CLA_TASK_7 = false;
cla1.cpuint_CLA_TASK_2 = false;
cla1.cpuint_CLA_TASK_3 = false;
cla1.cpuint_CLA_TASK_4 = false;
cla1.cpuint_CLA_TASK_5 = false;
cla1.cpuint_CLA_TASK_6 = false;
cla1.cpuint_CLA_TASK_7 = false;
cla1.cpuint_CLA_TASK_8 = false;
cla1.enable_CLA_TASK_8 = false;

const divider10 = system.clockTree["EPWMCLKDIV"];
scripting.suppress("ePWM TZFRC and TZCLR events will sometimes be missed when EPWMCLKDIV is divide by 2\\. Always program EPWMCLKDIV to divide by 1 if using TZFRC or TZCLR register\\. Please refer to the F2838x Silicon Errata for more details\\.", divider10, "EPWMCLK");

cputimer1.$name                    = "myCPUTIMER0";
cputimer1.timerPrescaler           = 199;
cputimer1.timerPeriod              = 1000;
cputimer1.enableInterrupt          = true;
cputimer1.registerInterrupts       = true;
cputimer1.startTimer               = true;
cputimer1.timerInt.enableInterrupt = true;

cputimer2.$name                    = "myCPUTIMER1";
cputimer2.cputimerBase             = "CPUTIMER1_BASE";
cputimer2.timerPrescaler           = 199;
cputimer2.enableInterrupt          = true;
cputimer2.registerInterrupts       = true;
cputimer2.timerPeriod              = 1000;
cputimer2.startTimer               = true;
cputimer2.timerInt.enableInterrupt = true;

cputimer3.$name                    = "myCPUTIMER2";
cputimer3.cputimerBase             = "CPUTIMER2_BASE";
cputimer3.timerPrescaler           = 199;
cputimer3.timerPeriod              = 1000;
cputimer3.enableInterrupt          = true;
cputimer3.startTimer               = true;
cputimer3.registerInterrupts       = true;
cputimer3.timerInt.enableInterrupt = true;

const default_warning = scripting.addModule("/driverlib/default_warning.js", {}, false);
scripting.suppress("Add the \'Device Support\' module in order to use Clock Tree tool and generate device support files\\. This suggestion can be ignored if not using the Clock Tree tool\\.", default_warning);

gpio1.$name     = "STEP";
gpio1.direction = "GPIO_DIR_MODE_OUT";
gpio1.$hardware = system.deviceData.board.components.D1;

memcfg.config_MEMCFG_SECT_LS1 = "CLA_data";
memcfg.config_MEMCFG_SECT_LS5 = "CLA_prog";
memcfg.config_MEMCFG_SECT_LS0 = "CLA_data";

sci1.$name                      = "mySCI0";
sci1.$hardware                  = system.deviceData.board.components.SCI_LOC1;
sci1.rxFifo                     = "SCI_FIFO_RX1";
sci1.enabledFIFOInterrupts      = ["SCI_INT_RXFF"];
sci1.selectRegisteredInterrupts = ["registerRxInt"];
sci1.rxQual.$name               = "myGPIOQUAL0";
sci1.txQual.$name               = "myGPIOQUAL1";
sci1.sciRXInt.enableInterrupt   = true;

/**
 * Pinmux solution for unlocked pins/peripherals. This ensures that minor changes to the automatic solver in a future
 * version of the tool will not impact the pinmux you originally saw.  These lines can be completely deleted in order to
 * re-solve from scratch.
 */
led1.gpio.gpioPin.$suggestSolution  = "hsecDigital.86";
gpio1.gpioPin.$suggestSolution      = "hsecDigital.82";
sci1.sci.$suggestSolution           = "SCIA";
sci1.sci.sci_rxPin.$suggestSolution = "hsecDigital.76";
sci1.sci.sci_txPin.$suggestSolution = "hsecDigital.78";
